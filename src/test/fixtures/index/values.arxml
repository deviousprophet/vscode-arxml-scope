AUTOSAR XML (schema 00048)
package /Synthetic
  module config SampleModule: definition=SampleModuleDef, implementation-config-variant=VARIANT-PRE-COMPILE
    Main: TimeoutSeconds=42, Greeting=hello, PeerRef=Sub
      Sub: Retries=3
