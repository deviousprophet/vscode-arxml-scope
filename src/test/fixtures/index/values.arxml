AUTOSAR XML (schema 00048)
package /Synthetic
  module config SampleModule: uuid=0f8a6a1e-2a8f-4a2e-9d3b-6f2f0b1c4a10, definition=SampleModuleDef, implementation-config-variant=VARIANT-PRE-COMPILE
    Main: TimeoutSeconds=42, Greeting=hello, PeerRef=Sub
      Sub: Retries=3
