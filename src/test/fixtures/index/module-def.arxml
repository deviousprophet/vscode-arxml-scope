AUTOSAR XML (schema 00048)
package /Synthetic
  module definition SampleModuleDef [0..1]  # Synthetic module used by the index tests.
    container Main  # Main settings for the synthetic sample.
      integer TimeoutSeconds: lower-limit=0, upper-limit=65535, default-value=30  # Timeout in seconds.
      float SampleRate: 0.5..100, default-value=1.5
      boolean Enabled: default-value=true
      string Greeting: min-length=1, max-length=32, default-value=hello
      enumeration Mode: default-value=FAST  # Operating mode.
        FAST  # Fast mode.
        SLOW
      function name EntryPoint
      linker symbol BufferSymbol
      reference PeerRef [0..*]: destination=Other
      instance reference PeerIref: destination=SampleModule
