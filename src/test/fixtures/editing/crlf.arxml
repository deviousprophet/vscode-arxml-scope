AUTOSAR XML (schema 00048)
package /PkgE
  module config EditMod
    EditCont: IniValue=63, Title=hello
