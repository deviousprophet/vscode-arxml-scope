AUTOSAR XML (schema 00048)
package /PkgF
  module config ContMod
    FirstCont (FirstContRenamed): Count=7, Label=bee
    SiblingCont: Count=3
