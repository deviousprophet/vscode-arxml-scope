AUTOSAR XML (schema 00048)
package /PkgE
  module config EditMod
    EditCont: Count=7, Limit=10
