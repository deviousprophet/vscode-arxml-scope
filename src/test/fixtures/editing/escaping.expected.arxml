AUTOSAR XML (schema 00048)
package /PkgE
  module config EditMod
    EditCont: Pattern=a&b<c>d
