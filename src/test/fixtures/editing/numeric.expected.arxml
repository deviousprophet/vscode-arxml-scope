AUTOSAR XML (schema 00048)
package /PkgE
  module config EditMod
    EditCont: Count=42, Limit=10
