AUTOSAR XML (schema 00048)
package /PkgE
  module config EditMod
    EditCont: Label=bee, Note=keep
