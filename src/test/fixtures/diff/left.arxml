AUTOSAR XML (schema 4.0)
package /Pkg/Diff
  module config ModBeta
    ContBeta: BetaFlag=false
  module config ModAlpha
    ContKeep: Keep=1, Changed=10, Dup=alpha, Dup=beta, TargetRef=ContKeep
    ContRemoved: RemovedChild=gone
      ContRemovedNested: NestedValue=5
    ContParentA
      ContMoved: MovedValue=7
    ContParentB
