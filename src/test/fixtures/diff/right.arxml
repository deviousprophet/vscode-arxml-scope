AUTOSAR XML (schema 4.0)
package /Pkg/Diff
  module config ModAlpha
    ContKeep: Keep=1, Changed=11, Dup=beta, Dup=alpha, TargetRef=ContAdded
    ContAdded: AddedParam=3
      ContAddedNested: NestedText=new
    ContParentA
    ContParentB
      ContMoved: MovedValue=7
  module config ModBeta
    ContBeta: BetaFlag=false
