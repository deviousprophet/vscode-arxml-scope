AUTOSAR XML (schema 00048)
package /PkgA
  module config ModA: implementation-config-variant=VARIANT-PRE-COMPILE
    ContA: IniValue=63, Title=hello, PeerRef=ContB, PeerIref=ContB.ContA
      ContB: Text=nested
