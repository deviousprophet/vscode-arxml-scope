AUTOSAR XML (schema 4.0)
package /P
  module config M1
    NMH_MO_01_MAIN_BUS (MainBus): A=1
    NMH_MO_02_MAIN_BUS (MainBus): A=2
