AUTOSAR XML (schema 4.0)
package /P
  module config M1
    NM_EMPTY_01 (Empty)
