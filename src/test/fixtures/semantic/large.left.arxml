AUTOSAR XML (schema 4.0)
package /P
  module config M1
    600 x Many:
      NMH_{000..599}
