AUTOSAR XML (schema 4.0)
package /Pkg
  module config Mod
    4 x Child:
      Old_{0..3}_MO: P0=Old_{0..3}_MO_V_0, P1=Old_{0..3}_MO_V_1
