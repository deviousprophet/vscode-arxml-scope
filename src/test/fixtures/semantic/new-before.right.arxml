AUTOSAR XML (schema 4.0)
package /Pkg
  module config Mod
    5 x Child:
      Extra_0_MO: P0=Extra_0_MO_Z_0, P1=Extra_0_MO_Z_1
      Extra_1_MO: P0=Extra_1_MO_Z_0, P1=Extra_1_MO_Z_1
      New_{0..2}_MO: P0=New_{0..2}_MO_V_0, P1=New_{0..2}_MO_V_1
