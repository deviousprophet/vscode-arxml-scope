AUTOSAR XML (schema 4.0)
package /P
  module config M1
    4 x MainBus, all with P21=21, P22=22, P23=23, P24=24, P25=25, R1=CHILD_1, R2=CHILD_2, R3=CHILD_3, R4=CHILD_4, R5=CHILD_5, R6=CHILD_6, R7=CHILD_7, R8=CHILD_8, R9=CHILD_9, R10=CHILD_10, R11=CHILD_11, R12=CHILD_12, R13=CHILD_13, R14=CHILD_14, R15=CHILD_15, R16=CHILD_16, R17=CHILD_17, R18=CHILD_18, R19=CHILD_19, R20=CHILD_20:
      NMH_A_{01..04}
