AUTOSAR XML (schema 00048)
package /Pkg
  module config ModX
    ContA:
      SelfOff = 1 if sw-syscond=(CANIPCORETYPE_SC==0)
      Sibling = 2
      LiteralOff = 3 if sw-syscond=(1==0)
      Missing = 4 if sw-syscond=(MISSING_SC==1)
      Malformed = 5 if sw-syscond=(A==
      TrueCond = 6 if sw-syscond=(CANIPCORETYPE_SC==1)
      RefOff = ContB if sw-syscond=(CANIPCORETYPE_SC==0)
      ContB: variation-point=sw-syscond=(CANIPCORETYPE_SC==0), InsideNoCond=7, InsideTrue=8 if sw-syscond=(CANIPCORETYPE_SC==1)
    ContTrue: variation-point=sw-syscond=(CANIPCORETYPE_SC==1), Plain=9
  module config ModCond: variation-point=sw-syscond=(CANIPCORETYPE_SC==0)
    UnderMod: UnderModParam=10
