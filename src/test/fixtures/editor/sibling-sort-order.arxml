AUTOSAR XML (schema 00048)
package /Pkg
  module config Mod
    Twin (Zeta): Mark=1
    Twin (Alpha): Mark=2
