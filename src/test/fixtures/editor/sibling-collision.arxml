AUTOSAR XML (schema 00048)
package /Pkg
  module config Mod
    Twin: Mark=1
      Leaf: Mark=11
    Twin: Mark=2
      Leaf: Mark=22
