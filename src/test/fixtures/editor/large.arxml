AUTOSAR XML (schema 00048)
package /PkgLarge
  module config LargeMod
    Cont01: Alpha=1, Beta=2, Gamma=alpha, Delta=true, Epsilon=a longer textual value that is useful for checking ellipsis, Next=Cont02  # first container
    Cont02: Alpha=3, Beta=4, Gamma=beta, Delta=false, Epsilon=second, Next=Cont03
    Cont03: Alpha=5, Beta=6, Gamma=gamma, Delta=true, Epsilon=third
    Cont04: Alpha=7, Beta=8, Gamma=delta, Delta=false, Epsilon=fourth
    Cont05: Alpha=9, Beta=10, Gamma=epsilon, Delta=true, Epsilon=fifth
    Cont06: Alpha=11, Beta=12, Gamma=zeta, Delta=false, Epsilon=sixth
    Cont07: Alpha=13, Beta=14, Gamma=eta, Delta=true, Epsilon=seventh
    Cont08: Alpha=15, Beta=16, Gamma=theta, Delta=false, Epsilon=eighth
