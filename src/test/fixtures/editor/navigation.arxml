AUTOSAR XML (schema 00048)
package /PkgN
  module config NavMod
    NavCont: Alpha=7, Beta=bee, Good=NavCont, Missing=All, Ambiguous=Dup
    X
      Dup
    Y
      Dup
