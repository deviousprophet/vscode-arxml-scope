AUTOSAR XML (schema 00048)
package /PkgA/PkgB
  module config ModX: implementation-config-variant=VARIANT-PRE-COMPILE, variation-point={sw-syscond=(A == B), post-build-variant-conditions=[{matching-criterion=/PkgA/PkgB/ModDefs/Crit1, value=1}, {matching-criterion=/PkgA/PkgB/ModDefs/Crit2, value=2}]}  # Note module note
    ContA: IniValue=63, Title=hello, Flag=true, PeerRef=ContB, PeerIref=ContB.ContA  # container note
      ContB: Text=nested
