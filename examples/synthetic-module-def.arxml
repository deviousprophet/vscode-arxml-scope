AUTOSAR XML (schema 00048)
package /Synthetic
  module definition SampleModuleDef [0..1]  # Synthetic module definition used by the ARXML Scope examples.
    container Main  # Main settings for the synthetic sample.
      integer TimeoutSeconds: lower-limit=0, upper-limit=65535, default-value=30  # Timeout in seconds.
      float SampleRate: 0.5..100, default-value=1.5  # Sampling rate in hertz.
      boolean Enabled: default-value=true
      string Greeting: min-length=1, max-length=32, default-value=hello
      enumeration Mode: {FAST, SLOW}, default-value=FAST
      function name EntryPoint
      linker symbol BufferSymbol
      reference PeerRef [0..*]: destination=Main
      instance reference PeerIref: destination=Main
      container Sub [0..1]
        integer Retries: lower-limit=0, upper-limit=10, default-value=3
        string Label: max-length=16
    container Empty [0..1]
