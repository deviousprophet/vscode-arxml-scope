AUTOSAR XML (schema 00048)
package /Synthetic
  module config SampleModule: definition=SampleModuleDef, implementation-config-variant=VARIANT-PRE-COMPILE  # Sample Synthetic module used by the ARXML Scope examples.
    Main:  # Main settings for the synthetic sample.
      TimeoutSeconds = 42
      SampleRate = 3.5
      Enabled = true
      Greeting = hello
      Mode = FAST
      EntryPoint = Sample_Init
      BufferSymbol = sample_buffer
      PeerRef = Sub
      PeerIref = Sub.Main
      Sub: variation-point=sw-syscond=(SAMPLE_ENABLED == true), Retries=3, Label=sub
    Empty
